# file: spi.ioc
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Mcu.Family=STM32F4
Mcu.Name=STM32F407V(E-G)Tx
Mcu.Package=LQFP100
NVIC.PriorityGroup=NVIC_PRIORITYGROUP_4
PA13.Mode=Serial_Wire
PA13.Signal=SYS_JTMS-SWDIO
PA14.Mode=Serial_Wire
PA14.Signal=SYS_JTCK-SWCLK
ProjectManager.HeapSize=0x200
ProjectManager.StackSize=0x400
ProjectManager.TargetToolchain=MDK-ARM V5.27
RCC.48MHZClocksFreq_Value=84000000
RCC.AHBFreq_Value=168000000
RCC.APB1CLKDivider=RCC_HCLK_DIV4
RCC.APB1Freq_Value=42000000
RCC.APB1TimFreq_Value=84000000
RCC.APB2CLKDivider=RCC_HCLK_DIV2
RCC.APB2Freq_Value=84000000
RCC.APB2TimFreq_Value=168000000
RCC.CortexFreq_Value=168000000
RCC.HCLKFreq_Value=168000000
RCC.HSE_VALUE=25000000
RCC.HSI_VALUE=16000000
RCC.LSE_VALUE=32768
RCC.PLLM=8
RCC.PLLN=168
RCC.SYSCLKFreq_VALUE=168000000
RCC.SYSCLKSource=RCC_SYSCLKSOURCE_PLLCLK
RCC.VCOOutputFreq_Value=336000000
board=custom

// file: Core/Src/main.c
/* USER CODE BEGIN Header */
/**
  ******************************************************************************
  * @file           : main.c
  * @brief          : Main program body
  ******************************************************************************
  * @attention
  *
  * <h2><center>&copy; Copyright (c) 2021 STMicroelectronics.
  * All rights reserved.</center></h2>
  *
  * This software component is licensed by ST under BSD 3-Clause license,
  * the "License"; You may not use this file except in compliance with the
  * License. You may obtain a copy of the License at:
  *                        opensource.org/licenses/BSD-3-Clause
  *
  ******************************************************************************
  */
/* USER CODE END Header */
#include "main.h"
#include "gpio.h"

/* USER CODE BEGIN PV */
int CX,CY;

#define	CHX 	        0x90 	/* Channel X+ command*/
#define	CHY 	        0xd0	/* Channel Y+ command* */

#define TP_CS_Pin GPIO_ODR_OD3
#define TP_CS_GPIO_Port GPIOE

void TP_CS(char x)
{
	if(x)
	TP_CS_GPIO_Port->BSRR = TP_CS_Pin;
	else
	TP_CS_GPIO_Port->BSRR = (uint32_t)TP_CS_Pin << 16U;
}
/* USER CODE END PV */

void SystemClock_Config(void);

/* USER CODE BEGIN 0 */
uint8_t SPI_Transmit (uint8_t *data, int size)
{

	/************** STEPS TO FOLLOW *****************
	1. Wait for the TXE bit to set in the Status Register
	2. Write the data to the Data Register
	3. After the data has been transmitted, wait for the BSY bit to reset in Status Register
	4. Clear the Overrun flag by reading DR and SR
	************************************************/

	int i=0;
	while (i<size)
	{
	   while (!((SPI1->SR)&	SPI_SR_TXE)) {};  // wait for TXE bit to set -> This will indicate that the buffer is empty
	   SPI1->DR = data[i];  // load the data into the Data Register
	   i++;
	}

/*During discontinuous communications, there is a 2 APB clock period delay between the
write operation to the SPI_DR register and BSY bit setting. As a consequence it is
mandatory to wait first until TXE is set and then until BSY is cleared after writing the last
data.
*/
	while (!((SPI1->SR)&SPI_SR_TXE)) {};  // wait for TXE bit to set -> This will indicate that the buffer is empty
	while (((SPI1->SR)& SPI_SR_BSY)) {};  // wait for BSY bit to Reset -> This will indicate that SPI is not busy in communication

	//  Clear the Overrun flag by reading DR and SR
	uint8_t temp = SPI1->SR;
					temp = SPI1->DR;

	return temp;
}

void SPI_Receive (uint8_t *data, int size)
{
	/************** STEPS TO FOLLOW *****************
	1. Wait for the BSY bit to reset in Status Register
	2. Send some Dummy data before reading the DATA
	3. Wait for the RXNE bit to Set in the status Register
	4. Read data from Data Register
	************************************************/

	while (size)
	{
		while (((SPI1->SR)&	SPI_SR_BSY)) {};  // wait for BSY bit to Reset -> This will indicate that SPI is not busy in communication
		SPI1->DR = 0;  // send dummy data
		while (!((SPI1->SR) & SPI_SR_RXNE)){};  // Wait for RXNE to set -> This will indicate that the Rx buffer is not empty
	  *data++ = (SPI1->DR);
		size--;
	}
}

unsigned char WR_CMD (unsigned char cmd)
{
	unsigned char DataRX = 0;
	DataRX = SPI_Transmit(&cmd,1);
	return DataRX;
}

/**
 * @brief	delay function
 * @param	cnt: Delay value
 * @retval None
 */
static void delay_nus(int cnt)
{
	int i,us;
	for(i = 0;i<cnt;i++)
	{
		us = 400;
		while (us--)     /* delay	*/
		{
		}
	}
}

/**
 * @brief	read xpt2046 adc value
 * @param	None
 * @retval return adc value
 */
static int RD_AD(void)
{
	unsigned short buf,temp;

	temp = WR_CMD(0x00);
	buf = temp << 8;
	delay_nus(1);
	temp = WR_CMD(0x00);;
	buf |= temp;
	buf >>= 3;
	buf &= 0xfff;
	return buf;
}

/**
 * @brief	read xpt2046 channel X+ adc value
 * @param	None
 * @retval return channel X+ adc value
 */
int Read_X(void)
{
	unsigned short temp;
	TP_CS(0);
	delay_nus(1);
	WR_CMD(CHX);
	delay_nus(1);
	temp = RD_AD();
	TP_CS(1);
	return temp;
}

/**
 * @brief	read xpt2046 channel Y+ adc value
 * @param	None
 * @retval return channel Y+ adc value
 */
int Read_Y(void)
{
	unsigned short temp;
	TP_CS(0);
	delay_nus(1);
	WR_CMD(CHY);
	delay_nus(1);
	temp = RD_AD();
	TP_CS(1);
	return temp;
}

/**
 * @brief	read xpt2046 channel X+ channel Y+ adc value
 * @param	None
 * @retval return channel X+ channel Y+ adc value
 */
void TP_GetAdXY(int *x,int *y)
{
	int adx,ady;
	adx = Read_X();
	delay_nus(1);
	ady = Read_Y();
	*x = adx;
	*y = ady;
}
/* USER CODE END 0 */

int main(void)
{

  /* MCU Configuration--------------------------------------------------------*/

  /* Reset of all peripherals, Initializes the Flash interface and the Systick. */

  LL_APB2_GRP1_EnableClock(LL_APB2_GRP1_PERIPH_SYSCFG);
  LL_APB1_GRP1_EnableClock(LL_APB1_GRP1_PERIPH_PWR);

  NVIC_SetPriorityGrouping(NVIC_PRIORITYGROUP_4);

  /* System interrupt init*/

  /* Configure the system clock */
  SystemClock_Config();

  /* Initialize all configured peripherals */
  MX_GPIO_Init();
  /* USER CODE BEGIN 2 */
  RCC->AHB1ENR |= RCC_AHB1ENR_GPIOEEN;
	RCC->AHB1ENR |= RCC_AHB1ENR_GPIOBEN;

	GPIOE->MODER |= GPIO_MODER_MODE3_0;
	GPIOE->OSPEEDR |= GPIO_OSPEEDR_OSPEED3_0 | GPIO_OSPEEDR_OSPEED3_1;

	GPIOB->MODER |= GPIO_MODER_MODE3_1 | GPIO_MODER_MODE4_1 | GPIO_MODER_MODE5_1;
	GPIOB->OSPEEDR |= GPIO_OSPEEDR_OSPEED3_0 | GPIO_OSPEEDR_OSPEED3_1
									| GPIO_OSPEEDR_OSPEED4_0 | GPIO_OSPEEDR_OSPEED4_1
									| GPIO_OSPEEDR_OSPEED5_0 | GPIO_OSPEEDR_OSPEED5_1;

  GPIOB->AFR[0] |= GPIO_AFRL_AFSEL3_0 | GPIO_AFRL_AFSEL3_2
									|GPIO_AFRL_AFSEL4_0 | GPIO_AFRL_AFSEL4_2
									|GPIO_AFRL_AFSEL5_0 | GPIO_AFRL_AFSEL5_2;

  /************** STEPS TO FOLLOW *****************
	1. Enable SPI clock
	2. Configure the Control Register 1
	3. Configure the CR2
	************************************************/

	RCC->APB2ENR |= RCC_APB2ENR_SPI1EN;  // Enable SPI1 CLock

	SPI1->CR1 |= SPI_CR1_MSTR;  // Master Mode

	SPI1->CR1 |= SPI_CR1_BR_1 | SPI_CR1_BR_0;

	SPI1->CR1 |= SPI_CR1_SSI | SPI_CR1_SSM;  // SSM=1, SSi=1 -> Software Slave Management

	SPI1->CR2 = 0;

	SPI1->CR1 |= SPI_CR1_SPE;

  /* USER CODE END 2 */

  /* Infinite loop */
  while (1)
  {

    /* USER CODE BEGIN 3 */
		TP_GetAdXY(&CX,&CY);
		delay_nus(100);
  }
  /* USER CODE END 3 */
}

void SystemClock_Config(void)
{
  LL_FLASH_SetLatency(LL_FLASH_LATENCY_5);
  while(LL_FLASH_GetLatency()!= LL_FLASH_LATENCY_5)
  {
  }
  LL_PWR_SetRegulVoltageScaling(LL_PWR_REGU_VOLTAGE_SCALE1);
  LL_RCC_HSI_SetCalibTrimming(16);
  LL_RCC_HSI_Enable();

   /* Wait till HSI is ready */
  while(LL_RCC_HSI_IsReady() != 1)
  {

  }
  LL_RCC_PLL_ConfigDomain_SYS(LL_RCC_PLLSOURCE_HSI, LL_RCC_PLLM_DIV_8, 168, LL_RCC_PLLP_DIV_2);
  LL_RCC_PLL_Enable();

   /* Wait till PLL is ready */
  while(LL_RCC_PLL_IsReady() != 1)
  {

  }
  LL_RCC_SetAHBPrescaler(LL_RCC_SYSCLK_DIV_1);
  LL_RCC_SetAPB1Prescaler(LL_RCC_APB1_DIV_4);
  LL_RCC_SetAPB2Prescaler(LL_RCC_APB2_DIV_2);
  LL_RCC_SetSysClkSource(LL_RCC_SYS_CLKSOURCE_PLL);

   /* Wait till System clock is ready */
  while(LL_RCC_GetSysClkSource() != LL_RCC_SYS_CLKSOURCE_STATUS_PLL)
  {

  }
  LL_Init1msTick(168000000);
  LL_SetSystemCoreClock(168000000);
}

void Error_Handler(void)
{
  __disable_irq();
  while (1)
  {
  }
}

/************************ (C) COPYRIGHT STMicroelectronics *****END OF FILE****/
